// "Счётчик нажатий кнопки". Вторая кнопка "минусует" значение на LED-дисплее. При достижении 9999, счёт обнуляется. При нажатии на обе кнопки сразу значение на LED-дисплее обнуляется

int buttonState = 0;         // переменная для хранения состояния кнопки счётчика
int counter = 0; // переменная для подсчёта нажатий на кнопку
boolean flag = 0; // логическая переменная, которая хранит последнее состояние кнопки
boolean flag1 = 0; // логическая переменная, которая хранит последнее состояние кнопки 2

#include <TM1637.h> //подключаем библиотеку модуля TM1637
#define CLK 3 // Определяем пины для подключения TM1637 к плате Arduino
#define DIO 4 // Определяем пины для подключения TM1637 к плате Arduino
#define buttonPin 2 // Определяем пин для подключения кнопки счётчика
#define buttonZeroPin 5// Определяем пин для подключения кнопки обнуления счётчика

TM1637 tm1637(CLK, DIO); // создаём объект класса TM1637, в качестве параметров используем номера пинов подключения дисплея к Ардуине

void setup() {

  Serial.begin(9600);

  tm1637.init(); // инициализация модуля TM1637

  tm1637.set(BRIGHT_TYPICAL); // устанавливаем яркость дисплея

  pinMode(buttonPin, INPUT); // инициализируем пин, подключенный к кнопке счётчика, как вход
  pinMode(buttonZeroPin, INPUT); // инициализируем пин, подключенный к кнопке обнуления счётчика, как вход

  Serial.println(counter); // выводим в COM-порт состояние кнопки = переменной counter

}

void loop() {

  tm1637.display(counter); // выводим на LED-дисплей состояние кнопки (по умолчанию ноль)

  buttonState = digitalRead(buttonPin); // считываем значения с входа кнопки счётчика

  if (buttonState == HIGH && flag == 0) { // если кнопка нажата и переменная flag = 0
    counter ++; // прибавляем единицу к переменной счётчика
    flag = 1; // происходит только одно действие + защита от "дребезга"

    Serial.println(counter); // выводим в COM-порт состояние кнопки = значение счётчика

  }

  if (buttonState == LOW && flag == 1) {
    flag = 0;
  }
  if (counter > 9999) {
    counter = 0;
  }

  // вторая кнопка уменьшает значение на единицу

  if (digitalRead(buttonZeroPin) == HIGH && flag1 == 0) {
    counter--;
    flag1 = 1;
  }

  if (digitalRead(buttonZeroPin) == LOW && flag1 == 1) {
    flag1 = 0;
  }

  // при нажатии обеих кнопок сразу, значение на LED-дисплее обнуляется

  if (flag == 1 && flag1 == 1) {
    counter = 0;
  }

}

